## config/Kconfig
```kconfig
config ZMK_KEYMAP_LAYERS_MAX
    int "Maximum number of keymap layers"
    default 16
```

## config/west.yml
```yaml
# =============================================================================
# WEST MANIFEST — Firmware Dependencies
# =============================================================================
# Direct dependencies are pinned to immutable revisions. The only changed pin
# versus the qualified HID wire v1 baseline is zmk-dongle-display, whose
# dedicated Æklipse branch carries PHYSICAL_KEY_STATE support and epoch recovery.

manifest:
  remotes:
    - name: zmkfirmware
      url-base: https://github.com/zmkfirmware
    - name: cormoran
      url-base: https://github.com/cormoran
    - name: gpeye
      url-base: https://github.com/GPeye
    - name: hydro8
      url-base: https://github.com/Hydro8
    - name: keebs34
      url-base: https://github.com/keebs34
    - name: zzeneg
      url-base: https://github.com/zzeneg

  projects:
    - name: zmk-config-selenium
      remote: keebs34
      revision: a3ec3d1f0bdd7d0bbd4df95b0517379ad3e336a6
    - name: mario-peripheral-animation
      remote: gpeye
      revision: 1aa3950d6c86b4240b3f79d06bdbb04c5d920711
    - name: zmk
      remote: zmkfirmware
      revision: 641514a97db345f499dd50b0360e594270f008fe
      import: app/west.yml
    - name: zmk-behavior-runtime-sensor-rotate
      remote: cormoran
      revision: 8b1125ed676c1f5e14145d217984f33d0ebdcef4
    - name: zmk-module-ble-management
      remote: cormoran
      revision: 57738cc4fc6ba80e82a7ac57741a0339cb186cd4
    - name: zmk-module-battery-history
      remote: cormoran
      revision: 307755dd2ad4d320e14de162e8e5ef018f29d929
    - name: zmk-module-runtime-input-processor
      remote: cormoran
      revision: 43618985f8c9d5457cc333b7ca0733f2d361911e
    - name: zmk-dongle-display
      remote: hydro8
      revision: d136104c42e19830757831ca45ac3d4cab730f7b
    - name: zmk-raw-hid
      remote: zzeneg
      revision: 6a37765dfab6197292e7a9f47305dcf87386d56a

  self:
    path: config
```
